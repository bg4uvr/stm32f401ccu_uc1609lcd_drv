/*
 * uc1609.c
 *
 *  Created on: Apr 29, 2020
 *      Author: Li Jingchen
 */

#include "uc1609.h"

//定义字库
const uint8_t Font5x8[][5] =
{
{ 0x00, 0x00, 0x00, 0x00, 0x00 },		//' '	0x20
    { 0x00, 0x00, 0x4f, 0x00, 0x00 },	//'!'	0x21
    { 0x00, 0x07, 0x00, 0x07, 0x00 },	//'"'	0x22
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    { 0x55, 0x2A, 0x55, 0x2A, 0x55 }, };

const uint8_t Font816[][16] =
{
{ 0x00, 0x00, 0x00, 0x00, 0x00, 0x00, 0x00, 0x00,  // - -
    0x00, 0x00, 0x00, 0x00, 0x00, 0x00, 0x00, 0x00 },

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{ 0x80, 0xC0, 0x60, 0x30, 0x60, 0xC0, 0x80, 0x00,  // --
    0x07, 0x07, 0x04, 0x04, 0x04, 0x07, 0x07, 0x00 }, };

uint8_t disp_buf[1536];

//发送OLED命令
void lcd_sendcmd(uint8_t cmd)
{
  HAL_GPIO_WritePin(LCD_CD_GPIO_Port, LCD_CD_Pin, GPIO_PIN_RESET);
  HAL_SPI_Transmit(&hspi1, &cmd, 1, 200);
  HAL_GPIO_WritePin(LCD_CD_GPIO_Port, LCD_CD_Pin, GPIO_PIN_SET);
}

//OLED初始化函数
void lcd_init(void)
{
  //初始化OLED
  lcd_sendcmd(0xe2);						//显示屏复位指令
  lcd_sendcmd(0xa3);//设置帧速率[A0: 76fps, A1b: 95fps, A2b: 132fps, A3b: 168fps(fps: frame-per-second)]
  lcd_sendcmd(0xeb);						//设置LCD偏置比(亮度设置)
  lcd_sendcmd(0x2f);						//显示屏功耗设置
  lcd_sendcmd(0xc2);						//设置LCD映射控制
  lcd_sendcmd(0x81);					//设置SEG偏置电压(对比度) 双字节指令
  lcd_sendcmd(180); 					//设置SEG偏置电压(对比度) 双字节指令
  lcd_sendcmd(0xaf);						//开启显示指令

  //启动定时器10，开始定时DMA刷新
  HAL_TIM_Base_Start_IT(&htim10);
}

//清屏
void lcd_cls(uint8_t rev)
{
  for (uint16_t i = 0; i < 1536; i++)
    disp_buf[i] = rev ? 0xff : 0x00;
}

//在指定坐标显示一个6*8点阵ASCII字符
void display_one_char(uint8_t x, uint8_t y, char char_data, uint8_t rev)
{
  uint8_t i;

  uint16_t ptr = y * 192 + x + 1;		//显示偏移指针

  //写入5字节点阵数据
  for (i = 0; i < 5; i++)
  {
    disp_buf[ptr + i] =
        rev ? ~Font5x8[char_data - 0x20][i] : Font5x8[char_data - 0x20][i];
  }
}

//指定坐标显示一个6*8字符串
void display_list_char(uint8_t x, uint8_t y, char *data_s, uint8_t rev)
{
  while (*data_s)
  {
    display_one_char(x, y, *data_s, rev);  //显示单个字符
    data_s++;
    x += 6;

    if (x >= 186)
    {
      x = 0;
      y++;
      if (y > 7) return;
    }
  }
}

//显示8*16点阵ASCII字符函数
void display_816_char(uint8_t x, uint8_t y, char char_data, uint8_t rev)
{
  uint8_t i;

  uint16_t ptr = y * 192 + x;		//显示偏移指针

  //写入16字节点阵数字
  for (i = 0; i < 8; i++)
  {
    disp_buf[ptr + i] =
        rev ? ~Font816[char_data - 0x20][i] : Font816[char_data - 0x20][i];
  }

  ptr += 192;
  for (i = 0; i < 8; i++)
  {
    disp_buf[ptr + i] =
        rev ?
            ~Font816[char_data - 0x20][i + 8] :
            Font816[char_data - 0x20][i + 8];
  }
}

//指定坐标显示一个6*8字符串
void display_list_816(uint8_t x, uint8_t y, char *data_s, uint8_t rev)
{
  while (*data_s)
  {
    display_816_char(x, y, *data_s, rev);  //显示单个字符
    data_s++;
    x += 8;

    if (x >= 184)
    {
      x = 0;
      y += 2;
      if (y > 7) return;
    }
  }
}

/****************************************************************************
 * 名称：gui_point()
 * 功能：画点。
 * 入口参数：X		点所在列的位置
 *           Y		点所在行的位置
 *			左下角坐标为0,0
 *           DRAW_MODE	显示模式(1 画点     0 清点     2  反色）
 * 出口参数：无
 * 说明：操作失败原因是指定地址超出缓冲区范围。
 *
 ****************************************************************************/
void gui_point(uint8_t X, uint8_t Y, uint8_t draw_mode)
{

  if ((X >= 192) || (Y >= 64)) return;

  uint8_t PAGE_Y = 7 - Y / 8;		//列换算成PAGE
  uint8_t char_Y = Y % 8;		//算出要操作的位
  uint16_t ptr = PAGE_Y * 192 + X;	//计算当前坐标在缓存中的偏移

  switch (draw_mode %= 3)
  {
    case 0:
      disp_buf[ptr % 1536] = disp_buf[ptr] &= ~(1 << (7 - char_Y));
      break;
    case 1:
      disp_buf[ptr % 1536] = disp_buf[ptr] |= 1 << (7 - char_Y);
      break;
    case 2:
      disp_buf[ptr % 1536] = disp_buf[ptr] ^= 1 << (7 - char_Y);
      break;

    default:
      break;
  }
}

/***********************************************************************
 画一条x1,y1到x2,y2的直线
 (show=1画点，show=0清点)
 ***********************************************************************/
void glcd_line(int16_t x1, int16_t y1, int16_t x2, int16_t y2, uint8_t show)
{
  int16_t dy;
  int16_t dx;
  int16_t stepx, stepy, fraction;
  dy = y2 - y1;
  dx = x2 - x1;
  if (dy < 0)
  {
    dy = -dy;
    stepy = -1;
  }
  else
  {
    stepy = 1;
  }
  if (dx < 0)
  {
    dx = -dx;
    stepx = -1;
  }
  else
  {
    stepx = 1;
  }
  dy <<= 1;
  dx <<= 1;
  gui_point(x1, y1, show);
  if (dx > dy)
  {
    fraction = dy - (dx >> 1);
    while (x1 != x2)
    {
      if (fraction >= 0)
      {
        y1 += stepy;
        fraction -= dx;
      }
      x1 += stepx;
      fraction += dy;
      gui_point(x1, y1, show);
    }
  }
  else
  {
    fraction = dx - (dy >> 1);
    while (y1 != y2)
    {
      if (fraction >= 0)
      {
        x1 += stepx;
        fraction -= dy;
      }
      y1 += stepy;
      fraction += dx;
      gui_point(x1, y1, show);
    }
  }
}

/***********************************************************************
 以x,y为圆心，以radius为半径画贺
 (show=1画点，show=0清点)
 ***********************************************************************/
void glcd_circle(int16_t x, int16_t y, int16_t radius, uint8_t show)
{
  int16_t xc = 0;
  int16_t yc;
  int16_t p;
  yc = radius;
  p = 3 - (radius << 1);
  while (xc <= yc)
  {
    gui_point(x + xc, y + yc, show);
    gui_point(x + xc, y - yc, show);
    gui_point(x - xc, y + yc, show);
    gui_point(x - xc, y - yc, show);
    gui_point(x + yc, y + xc, show);
    gui_point(x + yc, y - xc, show);
    gui_point(x - yc, y + xc, show);
    gui_point(x - yc, y - xc, show);
    if (p < 0) p += (xc++ << 2) + 6;
    else p += ((xc++ - yc--) << 2) + 10;
  }
}

